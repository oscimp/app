/dts-v1/;
/plugin/;

/ {
	compatible = "xlnx,zynq-7000";

	fragment0 {
		target = <&fpga_full>;
		#address-cells = <1>;
		#size-cells = <1>;
		__overlay__ {
			#address-cells = <1>;
			#size-cells = <1>;

			firmware-name = "nco_perturbation_wrapper.bit.bin";

			perturb_nco: perturb_nco@43C40000{
				compatible = "ggm,nco_counter";
				reg = <0x43C40000 0xffff>;
			};

			perturb_ampl: perturb_ampl@43C00000{
				compatible = "ggm,axi_to_dac";
				reg = <0x43C00000 0xffff>;
			};

		};
	};
};
